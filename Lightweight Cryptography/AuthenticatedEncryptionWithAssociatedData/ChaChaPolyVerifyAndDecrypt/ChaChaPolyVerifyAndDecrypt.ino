#include <ChaChaPoly.h>

struct ADADTest
{
  const char *name;
  byte key[32];
  byte iv[8];
  byte ciphertext[96];
  byte data[16];
  byte tag[16];
};

static ADADTest const ChaChaPolyTest = {
  "ChaChaPoly-verify-decrypt",
  {0x37, 0x4C, 0x33, 0x53, 0x77, 0x53, 0x71, 0x61,
  0x34, 0x4D, 0x6E, 0x4D, 0x69, 0x50, 0x5A, 0x44,
  0x53, 0x55, 0x46, 0x78, 0x52, 0x79, 0x56, 0x65,
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  0xBD, 0xFA, 0x4E, 0x53, 0xB0, 0xF8, 0x0D, 0x54}
};

ChaChaPoly ADAD;

void performVerificationAndDecryption(const struct ADADTest *test, ChaChaPoly *cipher) {
  unsigned long start, elapsed;
  byte output[96] = {0};

  printHex(test->ciphertext, 96);
  Serial.println();
  start = millis();
  cipher->setKey(test->key, cipher->keySize());
  cipher->setIV(test->iv, cipher->ivSize());
  cipher->addAuthData(test->data, 16);
  cipher->decrypt((uint8_t*) output, (uint8_t*)test->ciphertext, sizeof(test->ciphertext));
  if (cipher->checkTag(test->tag, 16)) {
    Serial.print("Valid tag\n");
  } else {
    Serial.print("Invalid tag\n");
    return;
  }
  elapsed = millis() - start;
  for (short i=0; i < 96; i++) {
    Serial.print((char)output[i]);
  }
  Serial.println(); Serial.print(elapsed); Serial.print(" milliseconds \n");
}

void printHex(const uint8_t *input, size_t len) {
  for (short i=0; i < len; i++) {
    if (i % 8 == 0) {
      Serial.println();
    }
    Serial.print("0x");
    if (input[i] < 16) {
      Serial.print('0'); 
    }
    Serial.print(input[i], HEX);
    if (i+1 != len) {
      Serial.print(", ");
    }
 }
}

void setup() {
  Serial.begin(9600);
  Serial.println();
  Serial.print(ChaChaPolyTest.name);
  Serial.println();
  performVerificationAndDecryption(&ChaChaPolyTest, &ADAD);
}

void loop() {
}
