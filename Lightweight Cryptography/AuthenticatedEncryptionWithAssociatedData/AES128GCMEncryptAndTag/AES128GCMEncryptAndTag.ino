#include <AES.h>
#include <GCM.h>

struct AEADTest
{
  const char *name;
  byte key[16];
  byte iv[16];
  byte plaintext[96];
  byte data[16];
};

static AEADTest const AES128GCMTest = {
  "AES-128-GCM-encrypt-tag",
  {0x37, 0x4C, 0x33, 0x53, 0x77, 0x53, 0x71, 0x61,
  0x34, 0x4D, 0x6E, 0x4D, 0x69, 0x50, 0x5A, 0x44},
  {0x50, 0x55, 0x71, 0x78, 0x33, 0x31, 0x7A, 0x36,
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  0x65, 0x64, 0x20, 0x64, 0x61, 0x74, 0x61, 0x2E}  
};

GCM<AES128> AEAD;

void performEncryptionAndTag(const struct AEADTest *test, GCM<AES128> *cipher) {
  unsigned long start, elapsed;
  byte output[96] = {0}, tag[16] = {0};

  for (short i=0; i < 96; i++) {
    Serial.print((char)test->plaintext[i]);
  }
  Serial.println();
    for (short i=0; i < 16; i++) {
    Serial.print((char)test->data[i]);
  }
  Serial.println(); Serial.println();
  start = millis();
  cipher->setKey(test->key, cipher->keySize());
  cipher->setIV(test->iv, cipher->ivSize());
  cipher->addAuthData(test->data, 16);
  cipher->encrypt((uint8_t*) output, (uint8_t*)test->plaintext, sizeof(test->plaintext));
  cipher->computeTag(tag, sizeof(tag));
  elapsed = millis() - start;
  Serial.print("Ciphertext:");
  printHex(output, 96);
  Serial.println();
  Serial.print("Tag:");
  printHex(tag, 16);
  Serial.println(); Serial.print(elapsed); Serial.print(" milliseconds \n");
}

void printHex(const uint8_t *input, size_t len) {
 for (short i=0; i < len; i++) {
    if (i % 8 == 0) {
      Serial.println();
    }
    Serial.print("0x");
    if (input[i] < 16) {
      Serial.print('0'); 
    }
    Serial.print(input[i], HEX);
    if (i+1 != len) {
      Serial.print(", ");
    }
 }
}

void setup() {
  Serial.begin(9600);
  Serial.println();
  Serial.print(AES128GCMTest.name);
  Serial.println();
  performEncryptionAndTag(&AES128GCMTest, &AEAD);
}

void loop() {
}
