#include <AES.h>
#include <EAX.h>

struct ADADTest
{
  const char *name;
  byte key[16];
  byte iv[16];
  byte ciphertext[96];
  byte data[16];
  byte tag[16];
};

static ADADTest const AES128EAXTest = {
  "AES-128-EAX-verify-decrypt",
  {0x37, 0x4C, 0x33, 0x53, 0x77, 0x53, 0x71, 0x61,
  0x34, 0x4D, 0x6E, 0x4D, 0x69, 0x50, 0x5A, 0x44},
  {0x50, 0x55, 0x71, 0x78, 0x33, 0x31, 0x7A, 0x36,
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  0x97, 0xED, 0xF6, 0x00, 0xCF, 0x27, 0xAF, 0x4E}
};

EAX<AES128> ADAD;

void performVerificationAndDecryption(const struct ADADTest *test, EAX<AES128> *cipher) {
  unsigned long start, elapsed;
  byte output[96] = {0};

  printHex(test->ciphertext, 96);
  Serial.println();
  start = millis();
  cipher->setKey(test->key, cipher->keySize());
  cipher->setIV(test->iv, cipher->ivSize());
  cipher->addAuthData(test->data, 16);
  cipher->decrypt((uint8_t*) output, (uint8_t*)test->ciphertext, sizeof(test->ciphertext));
  if (cipher->checkTag(test->tag, 16)) {
    Serial.print("Valid tag\n");
  } else {
    Serial.print("Invalid tag\n");
    return;
  }
  elapsed = millis() - start;
  for (short i=0; i < 96; i++) {
    Serial.print((char)output[i]);
  }
  Serial.println(); Serial.print(elapsed); Serial.print(" milliseconds \n");
}

void printHex(const uint8_t *input, size_t len) {
  for (short i=0; i < len; i++) {
    if (i % 8 == 0) {
      Serial.println();
    }
    Serial.print("0x");
    if (input[i] < 16) {
      Serial.print('0'); 
    }
    Serial.print(input[i], HEX);
    if (i+1 != len) {
      Serial.print(", ");
    }
 }
}

void setup() {
  Serial.begin(9600);
  Serial.println();
  Serial.print(AES128EAXTest.name);
  Serial.println();
  performVerificationAndDecryption(&AES128EAXTest, &ADAD);
}

void loop() {
}
