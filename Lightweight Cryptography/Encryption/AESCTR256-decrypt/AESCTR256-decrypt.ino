#include <AES.h>
#include <CTR.h>

struct DecryptionTest
{
  const char *name;
  byte key[32];
  byte iv[16];
  byte ciphertext[96];
};

static DecryptionTest const AES256CTRTest = {
  "AES-256-CTR-decrypt",
  {0x37, 0x4C, 0x33, 0x53, 0x77, 0x53, 0x71, 0x61,
  0x34, 0x4D, 0x6E, 0x4D, 0x69, 0x50, 0x5A, 0x44,
  0x53, 0x55, 0x46, 0x78, 0x52, 0x79, 0x56, 0x65,
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  0xD0, 0xB3, 0xB0, 0x73, 0xBA, 0x31, 0x7E, 0x98
  }
};

CTR<AES256> cipher;

void performDecryption(const struct DecryptionTest *decryption, Cipher *cipher) {
  unsigned long start;
  unsigned long elapsed;
  byte output[96] = {0};

  printHex(decryption->ciphertext, 96);
  Serial.println();
  start = millis();
  cipher->setKey(decryption->key, cipher->keySize());
  cipher->setIV(decryption->iv, cipher->ivSize());
  cipher->decrypt((uint8_t*) output, (uint8_t*)decryption->ciphertext, sizeof(decryption->ciphertext));
  elapsed = millis() - start;
  for (short i=0; i < 96; i++) {
    Serial.print((char)output[i]);
  }
  Serial.println(); Serial.print(elapsed); Serial.print(" milliseconds \n");
}

void printHex(const uint8_t *input, size_t len) {
  for (short i=0; i < len; i++) {
    if (i % 8 == 0) {
      Serial.println();
    }
    Serial.print("0x");
    if (input[i] < 16) {
      Serial.print('0'); 
    }
    Serial.print(input[i], HEX);
    if (i+1 != len) {
      Serial.print(", ");
    }
 }
}

void setup() {
  Serial.begin(9600);
  Serial.println();
  Serial.print(AES256CTRTest.name);
  Serial.println();
  performDecryption(&AES256CTRTest, &cipher);
}

void loop() {
}
