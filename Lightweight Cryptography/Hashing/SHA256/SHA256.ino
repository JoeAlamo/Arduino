#include <SHA256.h>

#define HASH_SIZE 32

struct HashTest
{
  const char *name;
  byte key[32];
  byte ciphertext[96];
  byte data[16];
};

static HashTest const SHA256Test = {
  "SHA256-hash",
  {0x37, 0x4C, 0x33, 0x53, 0x77, 0x53, 0x71, 0x61,
  0x34, 0x4D, 0x6E, 0x4D, 0x69, 0x50, 0x5A, 0x44,
  0x53, 0x55, 0x46, 0x78, 0x52, 0x79, 0x56, 0x65,
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  0x65, 0x64, 0x20, 0x64, 0x61, 0x74, 0x61, 0x2E}
};

SHA256 hashAlgorithm;

void performHash(const struct HashTest *test, Hash *hashAlgorithm) {
  unsigned long start, elapsed;
  byte input[sizeof(test->ciphertext) + sizeof(test->data)] = {0}, output[HASH_SIZE] = {0};
  
  memcpy(input, test->ciphertext, 96);
  memcpy(input + 96, test->data, 16);
  Serial.print("Cipher text: \n"); printHex(test->ciphertext, 96); Serial.println();
  Serial.print("Associated data: \n"); 
  for (short i=0; i < 16; i++) {
    Serial.print((char)test->data[i]);
  }
  Serial.println();
  start = millis();
  hashAlgorithm->update(input, sizeof(input));
  hashAlgorithm->finalizeHMAC(test->key, sizeof(test->key), output, sizeof(output));
  elapsed = millis() - start;
  printHex(output, sizeof(output));
  Serial.println(); Serial.print(elapsed); Serial.print(" milliseconds \n");
}

void printHex(const uint8_t *input, size_t len) {
 for (short i=0; i < len; i++) {
    if (i % 8 == 0) {
      Serial.println();
    }
    Serial.print("0x");
    if (input[i] < 16) {
      Serial.print('0'); 
    }
    Serial.print(input[i], HEX);
    if (i+1 != len) {
      Serial.print(", ");
    }
 }
}

void setup() {
  Serial.begin(9600);
  Serial.println();
  Serial.print(SHA256Test.name);
  Serial.println();
  performHash(&SHA256Test, &hashAlgorithm);
}

void loop() {
}
